## app/apps/examples/audiotest/Kconfig
```kconfig
#
# For a description of the syntax of this configuration file,
# see the file kconfig-language.txt in the NuttX tools repository.
#

config EXAMPLES_AUDIOTEST
	tristate "Audio output test"
	default n
	depends on AUDIO
	---help---
		Enable a self-contained audio output test.

		It synthesises a PCM stream in RAM (a tone, or a sweep with -s)
		and writes it to an audio device, so a successful run exercises
		the whole path at once: the application, the PCM decoder, the
		codec driver, I2S/DMA and the codec itself.

		It needs neither an SD card nor a network, which is what makes it
		usable as a bring-up check on a board whose storage is not up yet.

if EXAMPLES_AUDIOTEST

config EXAMPLES_AUDIOTEST_PROGNAME
	string "Program name"
	default "audiotest"
	---help---
		The name of the program that will be used when the NSH ELF
		program is installed.

config EXAMPLES_AUDIOTEST_PRIORITY
	int "Audio test task priority"
	default 100

config EXAMPLES_AUDIOTEST_STACKSIZE
	int "Audio test stack size"
	default 4096

config EXAMPLES_AUDIOTEST_DEVPATH
	string "Default audio device path"
	default "/dev/audio/pcm0"
	---help---
		The audio device used when none is given on the command line.
		The board's codec is registered here by the board bring-up.

endif # EXAMPLES_AUDIOTEST
```

## app/apps/examples/deskmate/Kconfig
```kconfig
#
# apps/examples/deskmate/Kconfig
#
# SPDX-License-Identifier: Apache-2.0
#
# For a description of the syntax of this configuration file,
# see the file kconfig-language.txt in the NuttX tools repository.
#

menuconfig EXAMPLES_DESKMATE
	tristate "DeskMate control-panel UI"
	default n
	depends on GRAPHICS_LVGL
	---help---
		DeskMate: the LVGL touch control-panel application layer for the
		openvela / ESP32-P4 board.

		It puts the four board capabilities into one product UI:

		  - camera   : V4L2 capture preview (/dev/video0)
		  - ethernet : eth0 link / address status
		  - WiFi     : wlan0 scan / connect / signal (wapi ioctls)
		  - touch    : /dev/input0 through the LVGL NuttX indev

		plus an agent bridge (local ai_agent over WebSocket, or a built-in
		offline responder) and a proactive event engine.

		The same application code also builds for the NuttX simulator and
		for the openvela goldfish emulator, where the display can be an
		in-memory buffer so the UI and its logic can be driven headless by
		the `dm_selftest` / script scenarios and snapshotted to PNG.

if EXAMPLES_DESKMATE

config EXAMPLES_DESKMATE_PROGNAME
	string "Program name"
	default "deskmate"

config EXAMPLES_DESKMATE_PRIORITY
	int "Task priority"
	default 100

config EXAMPLES_DESKMATE_STACKSIZE
	int "Stack size"
	default 32768

choice
	prompt "Display backend"
	default EXAMPLES_DESKMATE_DISPLAY_FBDEV if VIDEO_FB
	default EXAMPLES_DESKMATE_DISPLAY_MEM

config EXAMPLES_DESKMATE_DISPLAY_FBDEV
	bool "Framebuffer device (/dev/fb0)"
	depends on VIDEO_FB
	---help---
		Draw through the NuttX fbdev driver exposed by the board: the
		ESP32-P4 MIPI-DSI panel, the goldfish GPU framebuffer, or the
		simulator X11 window.

config EXAMPLES_DESKMATE_DISPLAY_MEM
	bool "In-memory display (headless)"
	---help---
		Let LVGL render into a full-screen buffer owned by the application.
		Needed on hosts without a framebuffer device (headless CI) and used
		as the deterministic snapshot source.

endchoice

config EXAMPLES_DESKMATE_WIDTH
	int "Display width (in-memory backend)"
	default 1024
	depends on EXAMPLES_DESKMATE_DISPLAY_MEM

config EXAMPLES_DESKMATE_HEIGHT
	int "Display height (in-memory backend)"
	default 600
	depends on EXAMPLES_DESKMATE_DISPLAY_MEM

config EXAMPLES_DESKMATE_FB_PATH
	string "Framebuffer device path"
	default "/dev/fb0"
	depends on EXAMPLES_DESKMATE_DISPLAY_FBDEV

config EXAMPLES_DESKMATE_INPUT_DEVPATH
	string "Touchscreen device path"
	default "/dev/input0"
	depends on INPUT_TOUCHSCREEN

config EXAMPLES_DESKMATE_HOSTFS_PATH
	string "Host directory to mount at /host (empty = none)"
	default ""
	---help---
		Simulator convenience: when non-empty the application mounts a NuttX
		hostfs exposing this host directory at /host, so snapshots taken
		inside the simulator land on the host where the test scripts read
		them.  Leave empty on real hardware.

config EXAMPLES_DESKMATE_EXIT_AFTER
	int "Exit automatically after N seconds (0 = never)"
	default 0
	---help---
		Headless test convenience: stop the UI loop and return after N
		seconds.  Zero keeps the application running until it is killed.

config EXAMPLES_DESKMATE_FONT_SIMSUN
	bool "Use the built-in SimSun 16 CJK font"
	default n
	select LV_FONT_SIMSUN_16_CJK
	---help---
		Fallback for CJK labels when the generated subset font is not
		available.  Costs roughly 150 KB of flash.

config EXAMPLES_DESKMATE_AGENT_MODE
	string "Agent bridge backend (mock | ws | off)"
	default "ws"
	---help---
		mock : offline responder, answers from the device state.  Makes the
		       conversation and the proactive engine testable without a
		       network or an API key.
		ws   : WebSocket client to the ai_agent built-in server
		       (127.0.0.1:28789 by default).
		off  : the bridge is disabled.

config EXAMPLES_DESKMATE_WIFI_BSS
	string "Write this wifi_sim BSS table at startup (empty = none)"
	default ""
	---help---
		Simulator convenience: the wifi_sim pseudo wireless driver reads its
		access point table from CONFIG_WIFI_SIM_CONFDIR/bss.  Point this at
		that file (e.g. "/tmp/wifi/bss" together with
		CONFIG_WIFI_SIM_CONFDIR="/tmp/wifi") to have the network page list
		access points on a host with no radio.

config EXAMPLES_DESKMATE_CAMERA_AUTOSTART
	bool "Open the camera at startup"
	default y
	---help---
		Interactive startup ("just run deskmate") opens the camera so the
		camera page has a picture immediately.  Evidence and diagnostic modes
		(--selftest, --tour, --wifi-*, --ap-probe) ignore this default on
		purpose: they must stay repeatable.  Disable here, or pass
		--no-camera, to boot with the camera closed.

config EXAMPLES_DESKMATE_AGENT_AUTOSPAWN
	bool "Start the built-in ai_agent at startup"
	default y
	depends on EXAMPLES_AI_AGENT_VELA
	---help---
		Interactive startup starts ai_agent as an in-process task and then
		connects the bridge to it over 127.0.0.1:28789, so the status badge
		reads "online" without the user typing anything first.

		Needs CONFIG_NET_LOOPBACK (otherwise 127.0.0.1 is routed to the
		default interface and never reaches the local listener).  Images
		without ai_agent ignore this symbol entirely.

		Turn it off here, or pass --no-agent-spawn, to keep the bridge in
		its Kconfig mode (mock / ws / off).

config EXAMPLES_DESKMATE_WLAN_AUTOSTART
	bool "Bring wlan0 up (and DHCP) at startup"
	default y
	---help---
		Interactive startup enables the wireless interface and asks for an
		address over DHCP, so the network page has a usable address without
		a manual "ifup wlan0" first.  Association is optional: see
		EXAMPLES_DESKMATE_WLAN_SSID.

		Images without a wireless netdev just log "no wireless interface"
		and continue.  Turn it off here, or pass --no-wlan.

config EXAMPLES_DESKMATE_WLAN_SSID
	string "Default STA SSID for the startup association (empty = none)"
	default ""
	depends on EXAMPLES_DESKMATE_WLAN_AUTOSTART
	---help---
		When non-empty, startup associates with this access point before
		requesting DHCP - useful for unattended deployment.

		Leave it empty when the companion firmware already associates by
		itself (the usual ESP-Hosted setup): the application then only does
		ifup + DHCP and does not disturb an existing link.

config EXAMPLES_DESKMATE_WLAN_PSK
	string "Default STA passphrase for the startup association"
	default ""
	depends on EXAMPLES_DESKMATE_WLAN_SSID
	---help---
		Passphrase used together with EXAMPLES_DESKMATE_WLAN_SSID.  Leave
		empty for an open network.

config EXAMPLES_DESKMATE_CAMERA_DEVPATH
	string "Camera device path"
	default "/dev/video0"
	---help---
		V4L2 capture device.  When it cannot be opened the camera HAL falls
		back to a synthetic moving pattern, which is what the simulator uses.

endif # EXAMPLES_DESKMATE
```

## board/esp32p4_vela/nuttx/boards/risc-v/esp32p4/esp32p4-function-ev-board/Kconfig
```kconfig
#
# For a description of the syntax of this configuration file,
# see the file kconfig-language.txt in the NuttX tools repository.
#

# This board is built through the "custom board" path: the defconfig selects
# ARCH_BOARD_CUSTOM and points ARCH_BOARD_CUSTOM_DIR at this directory, which
# makes CMake symlink this very file to $BINDIR/boards/dummy/Kconfig (sourced
# by boards/Kconfig).  Because the board is selected by directory rather than
# by a choice symbol, the conventional ARCH_BOARD_<name> symbol is not
# otherwise defined anywhere in this tree; declare it here so the rest of the
# file can use the usual guard.  Only this board's Kconfig is sourced for this
# board, so the symbol cannot leak into any other board's configuration.
config ARCH_BOARD_ESP32P4_FUNCTION_EV_BOARD
	bool
	default y
	depends on ARCH_CHIP_ESP32P4

if ARCH_BOARD_ESP32P4_FUNCTION_EV_BOARD

config ESP32P4_FUNCTION_EV_BOARD_LCD_POWER
	bool "LCD / MIPI-DSI power, reset and backlight path"
	default n
	select ESPRESSIF_LDO
	---help---
		At board bring-up, enable on-chip LDO channel 3 (ESP_LDO_VO3) at
		2500 mV for VDD_MIPI_DPHY, pulse the panel reset line and leave the
		backlight off until video is streaming.

		The MIPI-DSI/CSI PHY supply MUST be up before the DSI host is
		initialized, so this option is a prerequisite of
		ESP32P4_FUNCTION_EV_BOARD_MIPI_DSI.

		This option alone does not register the DSI host, initialize the
		panel, or create /dev/fb0.

if ESP32P4_FUNCTION_EV_BOARD_LCD_POWER

config ESP32P4_FUNCTION_EV_BOARD_LCD_RST
	bool "Drive the panel reset line (GPIO27)"
	default y
	---help---
		Pulse GPIO27 low for 10 ms and high for 20 ms before sending the
		panel initialization sequence.

		GPIO27 is NOT part of the LCD FPC pinout: it only reaches the panel
		adapter when the J1 -> J6 jumper is fitted.  Turn this off when the
		jumper is absent; nothing else needs to change.

config ESP32P4_FUNCTION_EV_BOARD_LCD_BL
	bool "Drive the backlight enable (GPIO26)"
	default y
	---help---
		Drive GPIO26 high once the DSI video stream is running and the
		panel has been switched on.

		GPIO26 is NOT part of the LCD FPC pinout: it only reaches the panel
		adapter when the J1 -> J6 jumper is fitted.  Turn this off when the
		jumper is absent (for example when the module backlight is always
		on) to avoid driving an unconnected pin.

endif # ESP32P4_FUNCTION_EV_BOARD_LCD_POWER

config ESP32P4_FUNCTION_EV_BOARD_MIPI_DSI
	bool "Register MIPI-DSI host at bring-up"
	default n
	depends on ESP32P4_FUNCTION_EV_BOARD_LCD_POWER && ESPRESSIF_MIPI_DSI
	---help---
		After the LCD power path succeeds, call esp_mipi_dsi_initialize()
		with the board's 2-lane / 900 Mbps bus configuration so the generic
		MIPI-DSI host is registered and LP DCS transfers are possible.

		Does not run panel initialization or create /dev/fb0 by itself;
		enable ESP32P4_FUNCTION_EV_BOARD_LCD for that.

config ESP32P4_FUNCTION_EV_BOARD_LCD
	bool "LCD panel (EK79007) and /dev/fb0"
	default n
	depends on ESP32P4_FUNCTION_EV_BOARD_MIPI_DSI
	select DRIVERS_VIDEO
	select VIDEO_FB
	select FB_UPDATE
	---help---
		Bring up the board's 7.0" 1024x600 MIPI-DSI panel module
		(AML070JGI50-07403L: EK79007 source driver + EK73217 gate driver),
		allocate a 1024x600 RGB565 framebuffer from the PSRAM heap, bind it
		to the DSI bridge through DW-GDMA and register /dev/fb0.

		The panel is initialized with the Espressif esp_lcd_ek79007 vendor
		sequence and driven with the matching 52 MHz DPI timing.

config ESP32P4_FUNCTION_EV_BOARD_LCD_APO_TEST
	bool "All-Pixels-On flash after FB bring-up"
	default n
	depends on ESP32P4_FUNCTION_EV_BOARD_LCD
	---help---
		After /dev/fb0 is ready, force All-Pixels-On for one second, then
		All-Pixels-Off and restore the solid red test fill.  Useful to
		separate "panel/backlight path works" from "video stream is
		configured correctly" during hardware bring-up.

config ESP32P4_FUNCTION_EV_BOARD_TOUCHSCREEN
	bool "GT911 touch screen controller"
	default n
	select INPUT
	select INPUT_GT9XX
	select ESPRESSIF_I2C0
	---help---
		Probe the GT911 capacitive touch controller on the shared I2C0 bus
		(SDA = GPIO7, SCL = GPIO8) and register it as /dev/input0.

		Neither the reset nor the interrupt line is routed to the SoC on
		this panel module, so the controller is polled: the GT9xx driver
		performs an I2C read per sample and attaches no interrupt handler.
		This is compatible with the LVGL NuttX touchscreen glue, which reads
		/dev/input0 from its own input timer.

config ESP32P4_FUNCTION_EV_BOARD_CAMERA
	bool "MIPI-CSI camera (SC2336) and /dev/video0"
	default n
	depends on ESPRESSIF_MIPI_CSI && VIDEO_SC2336
	select I2C
	---help---
		Bring up the MIPI-CSI capture path of the ESP32-P4X-C5-Function-EV
		Board and register it as a V4L2 capture device (/dev/video0).

		The board carries an AS-AG638A32M2-50 module built around the
		SmartSens SC2336 (1/3", 1920x1080) on a 2-lane MIPI CSI-2 link.

		The module has its own 24 MHz oscillator and its reset line is hard
		pulled to 3.3 V, so no clock or reset GPIO is driven.  The MIPI PHY
		supply (on-chip LDO channel 3 @ 2500 mV, shared with the DSI PHY) is
		acquired by esp_csi_imgdata_initialize(); it is reference counted,
		so enabling both the LCD and the camera is safe.

		The sensor SCCB interface shares I2C0 (SDA GPIO7, SCL GPIO8) with
		the GT911 touch controller.

		The CSI receiver window is fixed at the resolution configured by
		CONFIG_ESPRESSIF_MIPI_CSI_H_RES/_V_RES; resolution changes at
		run time are not supported yet.

config ESP32P4_FUNCTION_EV_BOARD_CAMERA_DEVPATH
	string "Camera capture device path"
	default "/dev/video0"
	depends on ESP32P4_FUNCTION_EV_BOARD_CAMERA

endif # ARCH_BOARD_ESP32P4_FUNCTION_EV_BOARD
```

## tools/test/p4_sdio_host_idf/sdkconfig.defaults
```kconfig
CONFIG_IDF_TARGET="esp32p4"
CONFIG_ESPTOOLPY_FLASHSIZE_16MB=y
CONFIG_FREERTOS_HZ=1000
CONFIG_ESP_MAIN_TASK_STACK_SIZE=8192
```
